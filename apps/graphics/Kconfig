## apps/graphics/Kconfig
```kconfig
#
# For a description of the syntax of this configuration file,
# see misc/tools/kconfig-language.txt.
#

config WEFLY_UI
	bool "Wefly graphics UI"
	default n
	---help---
		Enable the Wefly graphics user interface

config TIFF
	bool "TIFF file generation library"
	default n
	---help---
		Enable support for the TIFF file generation program.

if TIFF

menu "TIFF Screenshot Utility"
source "$APPSDIR/graphics/screenshot/Kconfig"
endmenu

endif
```

## nuttx/fs/yaffs2/Kconfig
```kconfig
#
# For a description of the syntax of this configuration file,
# see misc/tools/kconfig-language.txt.
#

config FS_YAFFS2
	bool "YAFFS2 file system"
	default n
	depends on !DISABLE_MOUNTPOINT
	select FS_READABLE
	select FS_WRITABLE
	select YAFFS_DIRECT
	select YAFFS_DEFINES_TYPES
	select YAFFS_PROVIDE_DEFS
	select YAFFSFS_PROVIDE_VALUES
	---help---
		Enable NuttX YAFFS2 file system support.

if FS_YAFFS2
endif
```
